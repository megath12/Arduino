const int a[250]={58.845,58.845,58.845,58.845,58.845,58.845,58.845,58.845,58.845,58.845,58.845,58.845,58.845,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62.5973,61.6922};
const int m[250]={0};
int J=PD_1,p,L,S=PF_1,B=PF_2,K=PF_3,data_received; 
int J2=PD_2,J3=PD_3,p2,p3,p4,L2,L3,L4;

void setup(){
  pinMode(K,OUTPUT); 
  pinMode(S,OUTPUT); 
  pinMode(B,OUTPUT); 
  pinMode(J,INPUT);
  Serial3.begin(9600);
  Serial.begin(9600);
}

void loop(){ 
    if (Serial3.available()){
      data_received = Serial3.read();  
      if (data_received == '1')
      {
        digitalWrite(K,LOW);  
        digitalWrite(B,LOW);
      for(int r=0;r<=249;r++){
         p=a[r];
         analogWrite(S,p);  
         L=analogRead(J);
         Serial.println(L);
         delay(4);          
      }
      
      }
      else if (data_received == '2'){
       for(int r2=0;r2<=249;r2++){
         digitalWrite(S,LOW);  
         digitalWrite(K,LOW);
         p2=a[r2];
         analogWrite(B,p2);  
         L2=analogRead(J);
         Serial.println(L2);
         delay(2);          
      }
      }
      else if (data_received == '3'){
       for(int r3=0;r3<=249;r3++){
         digitalWrite(S,LOW);  
         digitalWrite(B,LOW);
         p3=a[r3];
         analogWrite(K,p3);  
         L3=analogRead(J);
         Serial.println(L3);
         delay(8);          
      }
      } 
        else{
        digitalWrite(S,LOW);  
        digitalWrite(B,LOW); 
        digitalWrite(K,LOW);       
    }
    }
}
